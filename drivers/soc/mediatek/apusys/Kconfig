## drivers/soc/mediatek/apusys/Kconfig
```kconfig
# SPDX-License-Identifier: GPL-2.0-only

config MTK_APUSYS_PM
	tristate "MediaTek APUSYS Power Driver"
	select PM_GENERIC_DOMAINS
	depends on PM
	help
	  Enable Mediatek APU_TOP mtcmos control.
	  Support APU_TOP generic power domain multi-user use.
	  APU RPC HW for power on/off flow control and
	  execution in low level driver.
```
